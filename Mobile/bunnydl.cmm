; Batch Job for Target Based Programming of Intel 28F160C3 on MSM5000
; Flash on target 0--3FFFFF
; RAM on target 1380000--147FFFF
; 00.02.27 by chos

; processor specific settings for MSM5000
 SYStem.CPU arm7tdmi
 SYStem.Up

; set base envronment for MSM5000
 Data.Set 0300067c %WORD 01		; GPIO 14 ( PS_HOLD ) -> high
 Data.Set 03000668 %WORD 01
 Data.Set 04800080 %WORD 20ff	; ROM size & wait cycle ( 8M bytes, 15 wait )
 Data.Set 04800094 %WORD 0000
 Data.Set 048000a0 %WORD 0007	; enable Address line A20 & A21 & A22
 Data.Set 04800090 %WORD 0202	; enable RAM CS 1, x16 SRAM
 Data.Set 04800084 %WORD 2044	; RAM size & wait cycle ( 8M bytes, 4 wait )
 Data.Set 04800098 %WORD 0000	; RAM bus size

; load target program and make required settings for target based programming
 DATA.LOAD.ELF download\T32_INTEL\flash.elf
 r.s r13 1004000
 r.s r14 1008000

; set breakpoint at end of program
 B.S 1000004

; program start address, parameter+data start address, data buffer size
; start address of flash.elf is after push operations on stack
 FLASH.RESet
 FLASH.TARGET 1000000 1010000 60000
 FLASH.Create 0--05fffff TARGET WORD

 print "Erase Flash"

 local &addr
 &addr=2000
 while &addr<10000
 (
	flash.erase &addr++1fff

	print "...Erase  " &addr
	&addr=&addr+2000
 )
 while &addr<600000
 (
	flash.erase &addr++0ffff

	print "...Erase  " &addr
	&addr=&addr+10000
 )

 print "Program Flash"
 FLASH.Program ALL
; Data.LOAD.BINARY download\Bunny.bin 0 /word
 Data.LOAD.BINARY download\Bunny.bin 2000 /offset 2000 /word
 FLASH.Program off

; erase breakpoint at end of program
 B.D 1000004

 enddo

