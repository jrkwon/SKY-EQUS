;======================================================================================
;                                     LOAD4SCE.CMM
; 
; Load SURF4CE specific ELF file into Lauterbach emulator.  Sets up memory mapping
; and sets initial breakpoints.
;
; Copyright (c) 1999 by QUALCOMM, Incorporated.  All Rights Reserved.
;======================================================================================
;============================================================================
;
;                          EDIT HISTORY FOR MODULE
;
;  This section contains comments describing changes made to the module.
;  Notice that changes are listed in reverse chronological order.
;
; $Header:   L:/src/asw/MSM5000/VCS/load4sce.cmv   1.0   10 Sep 1999 18:14:54   lchan  $
;
; when       who     what, where, why
; --------   ---     --------------------------------------------------------
; 09/03/99   jeb     Set system.option WAIT to 0 to avoid interference with
;                    embedded file system flash accesses.
; 
;============================================================================

;-----------------------------------------------------------------
; Variable Declarations
;-----------------------------------------------------------------
global &srcdir
global &elfdir
global &ELFname
global &target
global &build
global &windows
global &analyzer

;-----------------------------------------------------------------
; User Specific Environment Features
;-----------------------------------------------------------------

; directory for source files
&srcdir= "."

; directory for ELF file. Default is "&srcdir"
&elfdir= "&srcdir"

; name of source ELF file
&ELFname= "surf4ce"

; name of analyzer window/scripts setup. Default is "al"
&analyzer= "al"

; name of windows setup file. Default is "windows"
&windows= "windows"

;-----------------------------------------------------------------
; Clear the emulator memory mapping system, clear all breakpoints,
; and initialize the target processor registers
;-----------------------------------------------------------------

        print "QUALCOMM T32 Emulator Configuration and Load"
        print "Copyright (c) 1999 by QUALCOMM, Incorporated, All Rights Reserved"

        do init

; Emulation memory wait states -
; Initialize system wait states to zero and rely on target wait states.
        System.Option WAIT 0

; Clear breakpoints
        break.reset

; Clear memory mapping
        map.reset

; Initialize processor registers
        r.reset

;-----------------------------------------------------------------
; Load the target memory mapping into the emulator
;-----------------------------------------------------------------

        do map_msm3

;----------------------------------------------------------------------------
; Load the target image file.  The /dualport option prevents the write cycles
; from being externalized to the target hardware.  This prevents writes cycles
; to the target ROM, and also reduces the time required to load the image.
;----------------------------------------------------------------------------
        print "Loading &ELFname.elf target image from &elfdir ..."

; Load target binary image
        Symbol.reset
        Symbol.Spath  &srcdir
        data.load.elf &elfdir\&ELFname.elf /dualport

;-----------------------------------------------------------------
; Set breakpoints at the processor exception vectors that are not
; expected as part of normal operation
;-----------------------------------------------------------------

; Reset vector
        b.set 00 /program

; Undefined instruction vector
        b.set 04 /program

; Sofware interrupt (SWI) handler
        b.set 08 /program

; Prefetch abort vector
        b.set 0c /program

; Data abort vector
        b.set 10 /program

;-----------------------------------------------------------------
; Set breakpoints at the software error handlers that can be
; called by the application
;-----------------------------------------------------------------

        b.set DBGBreak_32 /program /read /write
        b.set hw_power_off /program
        b.set err_fatal_put_log /program

; ----------------------------------------------------------------
; Exception Control Settings
; ----------------------------------------------------------------

  Exception.Enable  on
  Exception.Delay   on

;-----------------------------------------------------------------
; Set up Analyzer windows
;-----------------------------------------------------------------
do &analyzer

;-----------------------------------------------------------------
; Set up general windows
;-----------------------------------------------------------------
do &windows

enddo

