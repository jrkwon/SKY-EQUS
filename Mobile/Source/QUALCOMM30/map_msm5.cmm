;======================================================================================
;                                     MAP_MSM3.CMM
;
; Sets up MSM5000 emulation memory mapping.  Also includes protective breakpoints
; on ROM and RAM areas.
;
; Copyright (c) 1998, 1999 by QUALCOMM, Incorporated.  All Rights Reserved.
;======================================================================================

;=================================================================
;                 MSM5000 emulation memory map
;
;=================================================================

print "Loading target memory map..."

;-----------------------------------------------------------------
; Emulator map mode is set to FAST 
;-----------------------------------------------------------------

map.mode.fast

;-----------------------------------------------------------------
; Premap emulation memory to required target address ranges
;-----------------------------------------------------------------

map.pre 00000000--001FFFFF
map.pre 01000000--010FFFFF
map.pre 03000000--030FFFFF
map.pre 04800000--048FFFFF
map.pre 08000000--080FFFFF

;-----------------------------------------------------------------
; Map the program area to emulator internal RAM
;-----------------------------------------------------------------

map.ram     p:00000000--001fffff
map.intern  p:00000000--001fffff
map.protect p:00000000--001fffff

;-----------------------------------------------------------------
; Map the data area to emulator internal RAM
;-----------------------------------------------------------------

map.ram     d:01000000--010fffff
map.intern  d:01000000--010fffff

;-----------------------------------------------------------------
; Map the IO area to external memory
;-----------------------------------------------------------------

map.extern d:03000000--030fffff

;-----------------------------------------------------------------
; Map the ASB area to external memory
;-----------------------------------------------------------------

map.extern d:04800000--048fffff

;-----------------------------------------------------------------
; Illegal access detection
;-----------------------------------------------------------------

; Data read and write breakpoints at the reset vector
	break.set 0         /read /write

; Data write break points in the program area
	break.set 00000000--001fffff /write

; Instruction fetch break points in the data area
	break.set 01000008--010fffff /Program

enddo
