;============================================================================
;  Name:
;    JF160.CMM
;
;  Description:
;    FLASH Programming Script file for Lauterbach JTAG/ICD TRACE32.
;
;  Execution:
;    Modify the command line d.load.elf to load the file that you want.
;    Inside the debugger, type at the command line: "do jf160".
;    For more details, refer to jrreadme.txt in the Panther archive.
;
; Copyright (c) 1999 by QUALCOMM, Incorporated.  All Rights Reserved.
;----------------------------------------------------------------------------
;============================================================================
;
;                        EDIT HISTORY FOR MODULE
;
; $Header:   L:/src/asw/MSM5000/VCS/jf160.cmv   1.0   13 Oct 1999 11:17:52   lchan  $
;
; when       who     what, where, why
; -------    ---     --------------------------------------------------------
; 10/13/99   lcc     Created based on jfi16b3t.cmm in Panther archive.
;============================================================================;

;================
; Prepare system
;================
 B:
 sys.res
 sys.o.TURBO on
 sys.o.BigEndian off
 sys.o.ResBreak on
 sys.o.SHOWERROR on
 sys.o.EnReset on
 sys.o.TRST on
 sys.o.CFLUSH on
 sys.o.IFEN on             ; disable all interrupts

 sys.o.DisMode Auto

 sys.CPU ARM7TDMI

 sys.u

;==================================
; Init important MSM/ASB registers
;==================================
 ; MEMORY_WAIT1
 d.s 04800080 %w 0822 ; 2MB boundary, 2 WS for ROM1/2_CS/
 ; MEMORY_WAIT2
 d.s 04800084 %w 0122 ; 256kB boundary, 2 WS for RAM1/2_CS/ 
 ; BSIZER_CTL1
 d.s 04800094 %w 0000 ; ROM1/2_CS/ 
 ; BSIZER_CTL2
 d.s 04800098 %w 3000 ; RAM1/2_CS/ bus sizer enable 
 ; CS_CTL
 d.s 04800090 %w 0002 ; enable RAM1_CS/
 ; GPIO_INT_ADDR_SEL
 d.s 048000A0 %w 0001 ; enable A20
 
 ; any other important system init should be done here

;======================================================
; Load our flash programming routine and prepare flash
;======================================================
 d.load.aif "jf_f160.aif"
 ; need this breakpoint as per Lauterbach Spec so that we
 ; can hand back control to the Debugger
 break.set swbp
 ; reset our flash command
 flash.res
 ; let flash command know where our routine and buffer is located
 ; code at 0x1000000, data at 0x1008000, buffer size = 64K
 flash.target 1000000 1008000 10000 
 ; define our flash range and tell flash command we're using
 ; our own flash programming routine via keyword "target"
 ; right now, we are defining 1 MBytes
 flash.c 0--0FFFFF target word
 
 ; enable flash programming voltage
 ; on SURF, it's GPIO15 (pull it low)
 ; if this doesn't work, insert jumper 11 on MEM1100
 ; Set GPIO15 as output
 d.s 300067c %b 2
 ; Now drive it low
 d.s 3000668 %b 0

 ; first erase our flash
 flash.erase 0--0FFFFF

 ; put into program mode 
 flash.program all
 ; actual flash programming happens here
 d.load.elf "surf4pe.elf"  
 ; ok we're finished, turn off programming mode
 flash.program off
                                              
 ; disable flash programming voltage
 d.s 3000668 %b 2

 sys.res
 sys.d
 sys.o.TURBO on
 sys.o.BigEndian off
 sys.o.ResBreak on
 sys.o.SHOWERROR on
 sys.o.EnReset on
 sys.o.TRST on
 sys.o.CFLUSH on

 sys.o.DisMode Auto

 sys.CPU ARM7TDMI

 sys.u
 
 MAP.ROM 0--1FFFFF
 MAP.READONLY 0++1FFFFF

 b.delete

 sys.res
 sys.u
