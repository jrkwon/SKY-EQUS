;======================================================================================
;                                     AL.CMM
;
; Sets up default windows configuration for MSM3000 analyzer window.
;
; Copyright (c) 1998, 1999 by QUALCOMM, Incorporated.  All Rights Reserved.
;======================================================================================

 WINPAGE.CREATE Analyzer     
 
 WINCLEAR
 WINPOS 0.0 0.0 88. 25. 8. 1. W010
 E::A.L %timeauto %len 24 cpu l.nopfetch l.asm l.label l.queue l.nofetch TIME.BACK TIME.REF TIME.ZERO MODE PSYMBOL  Symboln
 
 WINPOS 0.0 19.0625 125. 18. 13. 1. W011
 E::d.lh /track
 
 WINPOS 89.625 0.0 34. 17. 0. 0. W012
 E::Register
 
enddo
