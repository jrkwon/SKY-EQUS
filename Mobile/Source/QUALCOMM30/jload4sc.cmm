;======================================================================================
;                                     LOAD4SP.CMM
; 
; Load SURFC specific ELF file into Lauterbach emulator.  Sets up memory mapping
; and sets initial breakpoints.
;
; Copyright (c) 1998, 1999 by QUALCOMM, Incorporated.  All Rights Reserved.
;======================================================================================

;============================================================================
;
;                          EDIT HISTORY FOR MODULE
;
;  This section contains comments describing changes made to the module.
;  Notice that changes are listed in reverse chronological order.
;
; $Header:   L:/src/asw/MSM5000/VCS/jload4sc.cmv   1.0   05 Oct 1999 13:21:44   lchan  $
;
; when       who     what, where, why
; --------   ---     --------------------------------------------------------
; 09/13/99   lcc     Initial release.
; 
;============================================================================
;-----------------------------------------------------------------
; User Specific Environment Features
;-----------------------------------------------------------------

; directory for source files
&srcdir= "."

; directory for ELF file. Default is "&srcdir"
&elfdir= "&srcdir"

; name of source ELF file
&ELFname= "surf4c"

; -----------------------------------------------------------
; --- Executes the command line arguement as a PRACTICE file ---
; -----------------------------------------------------------
;clear the TRACE32 screen
WinCLEAR

;select CPU type
SYStem.CPU ARM7TDMI

;set debug c

;restart CPU with debug mode
SYStem.Up

; Delete all existing windows.
  WinPage.Reset

; Turbo mode of debug state accesses - CPU makes no checks of memory access in debug mode
  System.Option TURBO on

; Usage of TRST in system - Must be off if reset tied to trst.
  System.Option.ResBreak off

; Disable "Emulator berr error"
  System.Option ShowError OFF


; Disassembler selection - Automatically selects correct one.
  System.Option DisMode Auto


; DLS ADDITIONS
SYSTEM.CPU ARM7TDMI
SYSTEM.OPTION BIGENDIAN OFF
SYSTEM.OPTION ENRESET OFF
;SYStem.BdmClock 500000


SYSTEM.UP
;MAP.ROM 0--1FFFFF
;MAP.READONLY 0++1FFFFF

;CONFIGURE the MSM ASB
;
; WAIT1
DATA.SET 04800080 %WORD 0422
; WAIT2
DATA.SET 04800084 %WORD 0422
; BUS SIZER1
DATA.SET 04800094 %WORD 0000
; GP CHIP SELECT WAIT
DATA.SET 04800088 %WORD 0004
; BUS SIZER2 (Set for 16 bit wide)
DATA.SET 04800098 %WORD 0000
; LCD CONTROL
DATA.SET 0480009C %WORD 0513
; CS CONTROL
DATA.SET 04800090 %WORD 0026
; GPIO INT ADDRESS
;DATA.SET 048000A0 %WORD 0007
; MSM WAIT
DATA.SET 0480008C %WORD 0008
; UP CLOCK CONTROL 1
DATA.SET 04800000 %WORD 000C
; UP CLOCK CONTROL 2
DATA.SET 04800004 %WORD 0001



; --------------------------------------------
; --- Setup environment defaults
; --------------------------------------------


  Symbol.AsmFrame on
  Symbol.CutLine 3
  Symbol.Spath + ".\"
  Symbol.case off


; --------------------------------------------
; --- Download and set initial breakpoints ---
; --------------------------------------------

; Load the target binary image and symbols
        print "Loading &ELFname.elf target image from &elfdir ..."
        Symbol.reset
        Symbol.Spath  &srcdir
        data.load.elf &elfdir\&ELFname.elf

; resets registers
  register.reset


  register.set pc __main


; Window Setup
  WinPage.Reset
  winpos 0% 0% 50% 50%
  WINPOS 0.0 0.0 101. 11. 13. 1. W000
  data.list

  WINPOS 0.0 16.0769 50. 11. 0. 0. W000
  Var.Local

  WINPOS 54.0 16.1538 50. 9. 0. 0. W002
  register

  end

